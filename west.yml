## zephyr_app/drivers/Kconfig
```kconfig
# Copyright (c) 2026
# SPDX-License-Identifier: GPL-3.0-or-later OR LicenseRef-Ostomachion-Commercial-1.0

menu "NEORV32 out-of-tree drivers"
rsource "spi/Kconfig"
rsource "i2c/Kconfig"
rsource "wdt/Kconfig"
rsource "accel/Kconfig"
endmenu

menu "Ostomachion platform"

config OSTOMACHION_HW_BUILD_ID
	string "Expected bitstream build ID string"
	default ""
	help
	  Set this to the build ID string written to build/xem7310/build_id.txt
	  by the Vivado build (format: <git-hash>_<YYYYMMDD_HHMMSS>).
	  At boot the FFT accelerator driver logs this value alongside a reminder
	  to verify it against the programmed bitstream.  An empty string (the
	  default) disables the check — suitable for development.

	  Example (in your prj.conf):
	    CONFIG_OSTOMACHION_HW_BUILD_ID="abc1234e_20260318_120000"

endmenu

menu "Ostomachion test configuration"

config TEST_I2C_SLAVE_ADDR
	int "I2C slave address for hardware tests (0 = no slave / skip)"
	default 0
	range 0 127
	help
	  7-bit I2C slave address used by the optional slave-dependent tests
	  in tests/test_i2c.cpp.  Set to 0 (the default) to skip those tests
	  gracefully via zassume_true.

	  In simulation set to 80 (0x50) to exercise the GHDL I2C slave model.
	  On hardware, set to the address of any attached I2C device.

config TEST_I2C_BUS_SCAN
	bool "Run full I2C bus scan test (0x08–0x77)"
	default n
	help
	  Enables test_bus_scan which probes all 111 valid 7-bit I2C addresses.
	  This test takes ~50 ms of simulated time at 100 kHz I2C.  Enable for
	  hardware validation (prj_hw_test.conf); leave disabled for simulation
	  to keep the GHDL test run within its 400 ms simulation window.

config TEST_SPI_STRESS_COUNT
	int "Number of back-to-back SPI transfers in the stress test"
	default 16
	range 1 256
	help
	  Controls how many consecutive single-byte loopback transfers
	  test_stress_loopback executes.  Each transfer takes ~1 ms in GHDL
	  simulation (Zephyr polling overhead at 100 MHz), so the default of 16
	  fits within the 400 ms simulation window.  Set to 64 (or higher) in
	  prj_hw_test.conf for more thorough interrupt-driver state testing on
	  real hardware.

endmenu
```

## zephyr_app/drivers/accel/Kconfig
```kconfig
# Copyright (c) 2026
# SPDX-License-Identifier: Apache-2.0

config FFT_ACCEL
	bool "Ostomachion FFT accelerator driver"
	depends on DT_HAS_OSTOMACHION_FFT_ACCEL_ENABLED
	help
	  Enables the Zephyr MISC driver for the memory-mapped FFT hardware
	  accelerator.  Requires the matching DTS node (compatible =
	  "ostomachion,fft-accel") and the AXI DMA + BRAM peripherals to be
	  present in the design.

if FFT_ACCEL

module = FFT_ACCEL
module-str = fft_accel
source "subsys/logging/Kconfig.template.log_config"

config FFT_ACCEL_TIMEOUT_MS
	int "DMA completion timeout (milliseconds)"
	default 100
	range 10 10000
	help
	  Maximum time to wait for the S2MM DMA interrupt-on-completion after
	  a transfer is kicked off.  Increase on slow or heavily loaded systems.
	  Decrease to detect stalls faster on real-time applications.

endif # FFT_ACCEL
```

## zephyr_app/drivers/i2c/Kconfig
```kconfig
# Copyright (c) 2026
# SPDX-License-Identifier: GPL-3.0-or-later OR LicenseRef-Ostomachion-Commercial-1.0

config I2C_NEORV32
	bool "NEORV32 TWI (I2C) driver"
	default y
	depends on I2C
	depends on DT_HAS_NEORV32_TWI_ENABLED
	depends on SYSCON
	help
	  Enable NEORV32 TWI master driver.  Defaults to a polling (blocking)
	  implementation compatible with simulation.  Select
	  I2C_NEORV32_INTERRUPT for the interrupt-driven production path.

config I2C_NEORV32_INTERRUPT
	bool "NEORV32 TWI interrupt-driven transfers"
	depends on I2C_NEORV32
	default n
	help
	  When enabled the driver uses a state machine driven by the TWI FIRQ
	  (FIRQ 7) to transfer data asynchronously.  The calling thread is
	  suspended on a semaphore while the hardware runs, allowing other
	  Zephyr threads to execute concurrently.
	  Requires the interrupts property in the DTS TWI node (already present
	  in app.overlay).  Set to y in prj_fpga.conf for production hardware;
	  leave at n for simulation where polling is simpler and faster.
```

## zephyr_app/drivers/spi/Kconfig
```kconfig
# Copyright (c) 2026
# SPDX-License-Identifier: Apache-2.0

config SPI_NEORV32
	bool "NEORV32 SPI driver"
	default y
	depends on SPI
	depends on DT_HAS_NEORV32_SPI_ENABLED
	depends on SYSCON
	help
	  Enable NEORV32 SPI master driver.  Defaults to a polling (blocking)
	  implementation compatible with simulation.  Select
	  SPI_NEORV32_INTERRUPT for the interrupt-driven production path.

config SPI_NEORV32_INTERRUPT
	bool "NEORV32 SPI interrupt-driven transfers"
	depends on SPI_NEORV32
	default n
	help
	  When enabled the driver suspends the calling thread while the SPI
	  engine runs, allowing other Zephyr threads to execute concurrently.
	  Requires the interrupts property in the DTS SPI node (already present
	  in app.overlay).  Set to y in prj_fpga.conf for production hardware;
	  leave at n for simulation where polling is simpler and faster.
```

## zephyr_app/drivers/wdt/Kconfig
```kconfig
# Copyright (c) 2026
# SPDX-License-Identifier: GPL-3.0-or-later OR LicenseRef-Ostomachion-Commercial-1.0

config WDT_NEORV32
	bool "NEORV32 watchdog timer driver"
	default y
	depends on WATCHDOG
	depends on DT_HAS_NEORV32_WDT_ENABLED
	help
	  Enable the out-of-tree Zephyr driver for the NEORV32 WDT peripheral.
	  Requires IO_WDT_EN=true in the NEORV32 top-level generic map (set in
	  fpga/xem7310/xem7310_top.vhd for the production FPGA target).

	  The driver implements the Zephyr watchdog API (wdt_install_timeout,
	  wdt_setup, wdt_feed, wdt_disable).  Only reset mode is supported;
	  callbacks are not available because the NEORV32 WDT triggers a
	  hardware reset with no pre-reset IRQ.

	  STRICT mode is always enabled: an incorrect feed password or a write
	  to a locked CTRL register causes an immediate hardware reset.  Note
	  that STRICT alone does NOT prevent an ordinary wdt_disable() (a plain
	  CTRL write of 0) — see WDT_NEORV32_LOCK for tamper resistance.

if WDT_NEORV32

config WDT_NEORV32_LOCK
	bool "Lock the WDT configuration in wdt_setup()"
	default n
	help
	  Set the NEORV32 WDT CTRL LOCK bit in wdt_setup().  Once locked, the
	  CTRL register (including the EN bit) cannot be changed until the next
	  hardware reset, and wdt_disable() returns -EPERM.  Combined with the
	  always-on STRICT mode, this guarantees the watchdog cannot be silently
	  disabled by a runaway task — at the cost of making wdt_disable()
	  permanently unavailable for this boot.

	  Leave disabled (default) for development and for test suites that
	  exercise wdt_disable(); enable for production firmware that must not
	  allow the watchdog to be turned off.

endif # WDT_NEORV32
```
